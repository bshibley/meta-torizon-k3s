## conf/layer.conf
```bitbake
# We might have a conf and classes directory, append to BBPATH
BBPATH .= ":${LAYERDIR}"

# We have a recipes directory, add to BBFILES
BBFILES += "${LAYERDIR}/recipes*/*/*.bb ${LAYERDIR}/recipes*/*/*.bbappend"

BBFILE_COLLECTIONS += "meta-torizon-k3s"
BBFILE_PATTERN_meta-torizon-k3s := "^${LAYERDIR}/"
BBFILE_PRIORITY_meta-torizon-k3s = "90"

LAYERDEPENDS_meta-torizon-k3s = "meta-toradex-torizon meta-toradex-distro"
LAYERSERIES_COMPAT_meta-torizon-k3s = "kirkstone"
```
